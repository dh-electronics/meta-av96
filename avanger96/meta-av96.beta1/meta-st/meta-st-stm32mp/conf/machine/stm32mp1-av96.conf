## avanger96/meta-av96.beta1/meta-st/meta-st-stm32mp/conf/machine/stm32mp1-av96.conf
```bitbake
#@TYPE: Machine
#@NAME: stm32mp1-av96
#@DESCRIPTION: Configuration for Avenger96
#@NEEDED_BSPLAYERS:

# Configure STM32MP15 Rev.A support
STM32MP15_REVA_SUPPORT = "no"
# Configure boards Rev C support
STM32MP_BOARDS_REVC = "no"

include conf/machine/include/st-machine-common-stm32mp.inc

# Define specific common machine name
MACHINEOVERRIDES .= ":stm32mp1"

# =========================================================================
# Chip architecture
# =========================================================================
DEFAULTTUNE = "cortexa7thf-neon-vfpv4"
include conf/machine/include/tune-cortexa7.inc

# =========================================================================
# boot scheme
# =========================================================================
BOOTSCHEME_LABELS += "basic"
BOOTSCHEME_LABELS += "trusted"

# =========================================================================
# Machine settings
# =========================================================================
# Define list of devicetree per board
STM32MP_DT_FILES_EV += "stm32mp157c-ev1"
STM32MP_DT_FILES_EV += "stm32mp157a-av96"

# =========================================================================
# Machine features
# =========================================================================
MACHINE_FEATURES += "${@'gpu' if d.getVar('ACCEPT_EULA_'+d.getVar('MACHINE')) == '1' else ''}"
# Splashscreen enabled
MACHINE_FEATURES += "splashscreen"

# =========================================================================
# Image
# =========================================================================
# Add ubi FSTYPES to default ones for nand volumes
IMAGE_FSTYPES += "stmultiubi"

# =========================================================================
# Kernel
# =========================================================================
# Kernel config
# Set this address to 0xC2000040, which is 0xC2000000 + 0x40.
# 0xC2000000 is the memory address where U-Boot will copy from flash the file uImage and 0x40 is uImage header size (64Bytes).
# With this value, U-Boot will be able to execute in place the zImage contained in uImage.
ST_KERNEL_LOADADDR   = "0xC2000040"

# For eval board: auto-load goodix module (touchscreen module)
KERNEL_MODULE_AUTOLOAD = "goodix"

# =========================================================================
# flashlayout
# =========================================================================
# Define the config labels to use to generate flashlayout file
FLASHLAYOUT_CONFIG_LABELS += "emmc"
FLASHLAYOUT_CONFIG_LABELS += "nor-sdcard"
FLASHLAYOUT_CONFIG_LABELS += "nor-emmc"
FLASHLAYOUT_CONFIG_LABELS += "sdcard"

# =========================================================================
# M4 copro
# =========================================================================
# Define the devicetree for M4 example
M4_DEVICETREE += "stm32mp157c-dk2-m4-examples"
M4_DEVICETREE += "stm32mp157c-ev1-m4-examples"
```

## avanger96/meta-av96.thud/meta-av96/conf/layer.conf
```bitbake
# We have a conf and classes directory, add to BBPATH
BBPATH .= ":${LAYERDIR}"

# We have recipes-* directories, add to BBFILES
BBFILES += "${LAYERDIR}/recipes-*/*/*.bb \
            ${LAYERDIR}/recipes-*/*/*.bbappend"

BBFILE_COLLECTIONS += "meta-av96"
BBFILE_PATTERN_meta-av96 = "^${LAYERDIR}/"
BBFILE_PRIORITY_meta-av96 = "7"

LAYERDEPENDS_meta-av96 = "core"
LAYERSERIES_COMPAT_meta-av96 = "thud"
```

## avanger96/meta-av96/meta-st/meta-av96/conf/layer.conf
```bitbake
# We have a conf and classes directory, add to BBPATH
BBPATH .= ":${LAYERDIR}"

# We have recipes-* directories, add to BBFILES
BBFILES += "${LAYERDIR}/recipes-*/*/*.bb \
            ${LAYERDIR}/recipes-*/*/*.bbappend"

BBFILE_COLLECTIONS += "../meta-st/meta-av96-layer"
BBFILE_PATTERN_../meta-st/meta-av96-layer = "^${LAYERDIR}/"
BBFILE_PRIORITY_../meta-st/meta-av96-layer = "6"

UBOOT_CONFIG[stm32mp157a-av96-basic] = "stm32mp157a-av96${UBOOT_CONFIG_FILEPATTERN}${UBOOT_DEFCONFIG}"
UBOOT_EXTLINUX_FDT_stm32mp157a-av96-sdcard     = "/stm32mp157a-av96.dtb"
UBOOT_CONFIG_pn-u-boot-basic-stm32mp += "stm32mp157a-av96-basic"
```

## avenger96/meta-av96.alpha2/meta-st/meta-av96/conf/layer.conf
```bitbake
# We have a conf and classes directory, add to BBPATH
BBPATH .= ":${LAYERDIR}"

# We have recipes-* directories, add to BBFILES
BBFILES += "${LAYERDIR}/recipes-*/*/*.bb \
            ${LAYERDIR}/recipes-*/*/*.bbappend"

BBFILE_COLLECTIONS += "../meta-st/meta-av96-layer"
BBFILE_PATTERN_../meta-st/meta-av96-layer = "^${LAYERDIR}/"
BBFILE_PRIORITY_../meta-st/meta-av96-layer = "6"

KERNEL_DEVICETREE_append = " stm32mp157a-av96.dtb "

UBOOT_CONFIG[stm32mp157a-av96-basic] = "stm32mp157a-av96${UBOOT_CONFIG_FILEPATTERN}${UBOOT_DEFCONFIG}"
UBOOT_CONFIG[stm32mp157a-av96-trusted] = "stm32mp157a-av96${UBOOT_CONFIG_FILEPATTERN}${UBOOT_DEFCONFIG}"

UBOOT_EXTLINUX_FDT_stm32mp157a-av96-emmc       = "/stm32mp157a-av96.dtb"
UBOOT_EXTLINUX_FDT_stm32mp157a-av96-nand       = "/stm32mp157a-av96.dtb"
UBOOT_EXTLINUX_FDT_stm32mp157a-av96-nor-sdcard = "/stm32mp157a-av96.dtb"
UBOOT_EXTLINUX_FDT_stm32mp157a-av96-nor-emmc   = "/stm32mp157a-av96.dtb"
UBOOT_EXTLINUX_FDT_stm32mp157a-av96-sdcard     = "/stm32mp157a-av96.dtb"

UBOOT_CONFIG_pn-u-boot-basic-stm32mp += "stm32mp157a-av96-basic"
UBOOT_CONFIG_pn-u-boot-trusted-stm32mp += "stm32mp157a-av96-trusted"

UBOOT_EXTLINUX_TARGETS += "mp157a-av96_emmc"
UBOOT_EXTLINUX_TARGETS += "mp157a-av96_nand"
UBOOT_EXTLINUX_TARGETS += "mp157a-av96_nor-sdcard"
UBOOT_EXTLINUX_TARGETS += "mp157a-av96_nor-emmc"
UBOOT_EXTLINUX_TARGETS += "mp157a-av96_sdcard"

UBOOT_EXTLINUX_BOOTPREFIXES_mp157a-av96_emmc       = "${EXTLINUX_BOOTDEVICE_EMMC}_stm32mp157a-av96_"
UBOOT_EXTLINUX_BOOTPREFIXES_mp157a-av96_nand       = "${EXTLINUX_BOOTDEVICE_NAND}_stm32mp157a-av96_"
UBOOT_EXTLINUX_BOOTPREFIXES_mp157a-av96_nor-sdcard = "${EXTLINUX_BOOTDEVICE_NORSDCARD}_stm32mp157a-av96_"
UBOOT_EXTLINUX_BOOTPREFIXES_mp157a-av96_nor-emmc   = "${EXTLINUX_BOOTDEVICE_NOREMMC}_stm32mp157a-av96_"
UBOOT_EXTLINUX_BOOTPREFIXES_mp157a-av96_sdcard     = "${EXTLINUX_BOOTDEVICE_SDCARD}_stm32mp157a-av96_"

UBOOT_EXTLINUX_LABELS_mp157a-av96_emmc       = "stm32mp157a-av96-emmc"
UBOOT_EXTLINUX_LABELS_mp157a-av96_nand       = "stm32mp157a-av96-nand"
UBOOT_EXTLINUX_LABELS_mp157a-av96_nor-sdcard = "stm32mp157a-av96-nor-sdcard"
UBOOT_EXTLINUX_LABELS_mp157a-av96_nor-emmc   = "stm32mp157a-av96-nor-emmc"
UBOOT_EXTLINUX_LABELS_mp157a-av96_sdcard     = "stm32mp157a-av96-sdcard"

UBOOT_EXTLINUX_DEFAULT_LABEL_mp157a-av96_emmc       ?= "stm32mp157a-av96-emmc"
UBOOT_EXTLINUX_DEFAULT_LABEL_mp157a-av96_nand       ?= "stm32mp157a-av96-nand"
UBOOT_EXTLINUX_DEFAULT_LABEL_mp157a-av96_nor-sdcard ?= "stm32mp157a-av96-nor-sdcard"
UBOOT_EXTLINUX_DEFAULT_LABEL_mp157a-av96_nor-emmc   ?= "stm32mp157a-av96-nor-emmc"
UBOOT_EXTLINUX_DEFAULT_LABEL_mp157a-av96_sdcard     ?= "stm32mp157a-av96-sdcard"

UBOOT_EXTLINUX_ROOT_stm32mp157a-av96-emmc       = "${EXTLINUX_ROOT_EMMC}"
UBOOT_EXTLINUX_ROOT_stm32mp157a-av96-nand       = "${EXTLINUX_ROOT_NAND}"
UBOOT_EXTLINUX_ROOT_stm32mp157a-av96-nor-sdcard = "${EXTLINUX_ROOT_NORSDCARD}"
UBOOT_EXTLINUX_ROOT_stm32mp157a-av96-nor-emmc   = "${EXTLINUX_ROOT_NOREMMC}"
UBOOT_EXTLINUX_ROOT_stm32mp157a-av96-sdcard     = "${EXTLINUX_ROOT_SDCARD}"
```

## avenger96/meta-av96.beta1/meta-st/meta-av96/conf/layer.conf
```bitbake
# We have a conf and classes directory, add to BBPATH
BBPATH .= ":${LAYERDIR}"

# We have recipes-* directories, add to BBFILES
BBFILES += "${LAYERDIR}/recipes-*/*/*.bb \
            ${LAYERDIR}/recipes-*/*/*.bbappend"

BBFILE_COLLECTIONS += "../meta-st/meta-av96"
BBFILE_PATTERN_../meta-st/meta-av96 = "^${LAYERDIR}/"
BBFILE_PRIORITY_../meta-st/meta-av96 = "7"
```

## conf/layer.conf
```bitbake
# We have a conf and classes directory, add to BBPATH
BBPATH .= ":${LAYERDIR}"

# We have recipes-* directories, add to BBFILES
BBFILES += "${LAYERDIR}/recipes-*/*/*.bb \
            ${LAYERDIR}/recipes-*/*/*.bbappend \
            ${LAYERDIR}/../meta-security/meta-tpm/recipes-tpm2/*/*.bb \
            ${LAYERDIR}/../meta-security/meta-tpm/recipes-tpm2/*/*.bbappend"

BBFILE_COLLECTIONS += "meta-av96"
BBFILE_PATTERN_meta-av96 = "^${LAYERDIR}/"
BBFILE_PRIORITY_meta-av96 = "8"

LAYERDEPENDS_meta-av96 = "core"
LAYERSERIES_COMPAT_meta-av96 = "thud"

BBMASK += "meta-security/recipes-*"
RM_WORK_EXCLUDE += "tf-a-stm32mp u-boot-stm32mp linux-stm32mp u-boot-stm32mp-extlinux m4projects-stm32mp1"

EULA_FILE_ST_stm32mp1-av96-common = "${LAYERDIR}/conf/eula/${MACHINE}"
EULA_FILE_ST_MD5SUM_stm32mp1-av96-common = "8b505090fb679839cefbcc784afe8ce9"
```

## conf/machine/stm32mp1-av96.conf
```bitbake
#@TYPE: Machine
#@NAME: stm32mp1-mx
#@DESCRIPTION: Configuration for STM32CubeMX generated project
#@NEEDED_BSPLAYERS: layers/meta-openembedded/meta-oe layers/meta-openembedded/meta-python

###########################################################################
#
# Default machine configuration sections
#
###########################################################################

include conf/machine/include/st-machine-common-stm32mp.inc
include conf/machine/include/st-machine-providers-stm32mp.inc

# Define specific common machine name
MACHINEOVERRIDES .= ":stm32mpcommonmx"

# =========================================================================
# Chip architecture
# =========================================================================
DEFAULTTUNE = "cortexa7thf-neon-vfpv4"
include conf/machine/include/tune-cortexa7.inc

# =========================================================================
# Machine settings
# =========================================================================
STM32MP_DEVICETREE = "${CUBEMX_DTB}"
UBOOT_EXTLINUX_TARGETS_EXTRA_CONFIG_target-sdcard += "stm32mp157a-av96-m4-sensors stm32mp157a-av96"
UBOOT_EXTLINUX_TARGETS_EXTRA_CONFIG_target-emmc += "stm32mp157a-av96-m4-sensors stm32mp157a-av96"
UBOOT_EXTLINUX_TARGETS_EXTRA_CONFIG_target-nor-sdcard += "stm32mp157a-av96-m4-sensors stm32mp157a-av96"

CUBE_M4_EXAMPLES_DT += "stm32mp157a-av96-mez-cam1"
CUBE_M4_EXAMPLES_DT += "stm32mp157a-av96-m4-sensors"
UBOOT_EXTLINUX_TARGETS_EXTRA_CONFIG = "stm32mp157a-av96"
UBOOT_EXTLINUX_TARGETS_EXTRA_CONFIG[stm32mp157a-av96] = "mez-cam1 m4-sensors"
UBOOT_EXTLINUX_MENU_DESCRIPTION_mez-cam1 = "Shiratech 96B-MEZ-CAM1 camera"
UBOOT_EXTLINUX_MENU_DESCRIPTION_m4-sensors = "M4-core demo on LTE-sensors board"
UBOOT_EXTLINUX_FDT_mez-cam1 = "/stm32mp157a-av96-mez-cam1.dtb"
UBOOT_EXTLINUX_FDT_m4-sensors = "/stm32mp157a-av96-m4-sensors.dtb"
UBOOT_EXTLINUX_MENU_DESCRIPTION = "Avenger96 without mezzanines"
UBOOT_EXTLINUX_DEFAULT_LABEL = "Avenger96 without mezzanines"

# =========================================================================
# Machine features (default for stm32mp1 like)
# =========================================================================
MACHINE_FEATURES += "splashscreen"
MACHINE_FEATURES += "watchdog"
MACHINE_FEATURES += "${@'gpu' if d.getVar('ACCEPT_EULA_'+d.getVar('MACHINE')) == '1' else ''}"
MACHINE_FEATURES += "m4copro"

# =========================================================================
# Device Storage
# =========================================================================
# Enable the board device storage support with CUBEMX_DTB according to BOOTDEVICE_LABELS
#DEVICE_BOARD_ENABLE_NAND    += "${@bb.utils.contains('BOOTDEVICE_LABELS', 'nand-4-256', '${CUBEMX_DTB}', '', d)}"
DEVICE_BOARD_ENABLE_NOR     += "${@bb.utils.contains('BOOTDEVICE_LABELS', 'nor-sdcard' , '${CUBEMX_DTB}', '', d)}"
DEVICE_BOARD_ENABLE_EMMC    += "${@bb.utils.contains('BOOTDEVICE_LABELS', 'emmc', '${CUBEMX_DTB}', '', d)}"
DEVICE_BOARD_ENABLE_SDCARD  += "${@bb.utils.contains('BOOTDEVICE_LABELS', 'sdcard', '${CUBEMX_DTB}', '', d)}"

# =========================================================================
# Flashlayout
# =========================================================================
# Set the FLASHLAYOUT_TYPE_LABELS to CUBEMX_DTB according to BOOTDEVICE_LABELS
FLASHLAYOUT_TYPE_LABELS_emmc        = "${@bb.utils.contains('BOOTDEVICE_LABELS', 'emmc', '${CUBEMX_DTB}', '', d)}"
#FLASHLAYOUT_TYPE_LABELS_nand-4-256  = "${@bb.utils.contains('BOOTDEVICE_LABELS', 'nand-4-256', '${CUBEMX_DTB}', '', d)}"
FLASHLAYOUT_TYPE_LABELS_nor-sdcard  = "${@bb.utils.contains('BOOTDEVICE_LABELS', 'nor-sdcard' , '${CUBEMX_DTB}', '', d)}"
FLASHLAYOUT_TYPE_LABELS_sdcard      = "${@bb.utils.contains('BOOTDEVICE_LABELS', 'sdcard', '${CUBEMX_DTB}', '', d)}"

# Specific settings for 'extensible' and 'deleteall' configurations
FLASHLAYOUT_CONFIG_LABELS_deleteall = "cubemx"
FLASHLAYOUT_TYPE_LABELS_deleteall_cubemx = "${CUBEMX_DTB}"
FLASHLAYOUT_TYPE_LABELS_extensible = "${CUBEMX_DTB}"

# =========================================================================
# CubeMX extra config
# =========================================================================
# Set specific subdir path by components for each device tree file location
# within CUBEMX_PROJECT project folder
CUBEMX_DTB_PATH_TFA     = "tf-a"
CUBEMX_DTB_PATH_TFA_SB  = "tf-a"
CUBEMX_DTB_PATH_UBOOT   = "u-boot"
CUBEMX_DTB_PATH_LINUX   = "kernel"
CUBEMX_DTB_PATH_OPTEEOS = "optee-os"

###########################################################################
#
# User machine customization sections
#
###########################################################################

# Boot Scheme
# =========================================================================
BOOTSCHEME_LABELS += "trusted"
#BOOTSCHEME_LABELS += "optee"
# WORKAROUND to generate U-BOOT SPL for DDR Tuning tools usage
UBOOT_CONFIG += "basic"


# Boot Device Choice
# =========================================================================
# Define the boot device supported
BOOTDEVICE_LABELS += "sdcard"
BOOTDEVICE_LABELS += "emmc"
#BOOTDEVICE_LABELS += "nand-4-256"
BOOTDEVICE_LABELS += "nor-sdcard"

# Support Feature Choice
# =========================================================================
# Define the features to enable on board
#MACHINE_FEATURES += "bluetooth"
#MACHINE_FEATURES += "wifi"

# Specific firmwares and kernel modules configuration
# =========================================================================
# Set the list of kernel module to be auto-loaded during boot
#KERNEL_MODULE_AUTOLOAD += ""

# Set Bluetooth related package list needed when 'bluetooth' feature is enabled
#BLUETOOTH_LIST += ""

# Set Wifi related package list needed when 'wifi' feature is enabled
#WIFI_LIST += ""

# CubeMX Project Config
# =========================================================================
# Assign CubeMX Board devicetree and project path name
CUBEMX_DTB = "stm32mp157a-av96"
CUBEMX_PROJECT = "cubemx_project/av96"

FLASHLAYOUT_PARTITION_SIZE_nor-sdcard_ssbl = "1024"
FLASHLAYOUT_PARTITION_SIZE_nor-sdcard_env = "256"
```

## meta-av96.thud/meta-av96/conf/layer.conf
```bitbake
# We have a conf and classes directory, add to BBPATH
BBPATH .= ":${LAYERDIR}"

# We have recipes-* directories, add to BBFILES
BBFILES += "${LAYERDIR}/recipes-*/*/*.bb \
            ${LAYERDIR}/recipes-*/*/*.bbappend \
            ${LAYERDIR}/../meta-security/meta-tpm/recipes-tpm2/*/*.bb \
            ${LAYERDIR}/../meta-security/meta-tpm/recipes-tpm2/*/*.bbappend"

BBFILE_COLLECTIONS += "meta-av96"
BBFILE_PATTERN_meta-av96 = "^${LAYERDIR}/"
BBFILE_PRIORITY_meta-av96 = "7"

LAYERDEPENDS_meta-av96 = "core"
LAYERSERIES_COMPAT_meta-av96 = "thud"

BBMASK += "meta-security/recipes-*"
RM_WORK_EXCLUDE += "tf-a-stm32mp u-boot-stm32mp linux-stm32mp"
```
