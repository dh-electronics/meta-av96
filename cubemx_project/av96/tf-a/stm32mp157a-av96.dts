// SPDX-License-Identifier: (GPL-2.0+ OR BSD-3-Clause)
/*
 * Copyright (C) Arrow Electronics 2019 - All Rights Reserved
 * Author: Botond Kardos <botond.kardos@arroweurope.com>
 */
/dts-v1/;

#include "stm32mp157.dtsi"
#include "stm32mp15xa.dtsi"
#include "stm32mp157a-av96-pinctrl.dtsi"
#include "stm32mp15xxac-pinctrl.dtsi"
#include <dt-bindings/soc/st,stm32-etzpc.h>

/ {
	model = "Arrow Electronics STM32MP157A Avenger96 board";
	compatible = "st,stm32mp157a-av96", "st,stm32mp157";
};

#include "stm32mp157a-av96.dtsi"
